## config/west.yml
```yaml
manifest:
  remotes:
    - name: zmkfirmware
      url-base: https://github.com/zmkfirmware
    - name: merlinov
      url-base: https://github.com/merlinov
  projects:
    - name: zmk
      remote: zmkfirmware
      revision: v0.3-branch
      import: app/west.yml
    - name: zmk-dongle-display
      remote: merlinov
      revision: main
  self:
    path: config
```

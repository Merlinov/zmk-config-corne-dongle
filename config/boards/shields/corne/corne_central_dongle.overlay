#include "corne.dtsi"

/ {
    chosen {
        zmk,kscan = &mock_kscan;
        zmk,matrix-transform = &default_transform;

        // Убраны строчки с дисплеем
        zephyr,display = &oled;
        zephyr_display = &oled;
    };

    mock_kscan: kscan_0 {
        compatible = "zmk,kscan-mock";
        columns = <0>;
        rows = <0>;
        events = <0>;
    };

    // Отключение светодиода
    led0: led_0 {
        status = "disabled";
    };
};



